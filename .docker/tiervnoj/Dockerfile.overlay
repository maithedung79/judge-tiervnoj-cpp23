FROM vnoj/judge-tiervnoj:latest

COPY dmoj/judge.py /judge/dmoj/judge.py
COPY dmoj/packet.py /judge/dmoj/packet.py
COPY dmoj/utils/helper_files.py /judge/dmoj/utils/helper_files.py
COPY dmoj/executors/OBJC.py /judge/dmoj/executors/OBJC.py
COPY dmoj/executors/CPP23.py /judge/dmoj/executors/CPP23.py
COPY dmoj/executors/CPPICPC.py /judge/dmoj/executors/CPPICPC.py

RUN set -ex; HOME=~judge . ~judge/.profile; runuser -u judge -w PATH -- /env/bin/dmoj-autoconf -V > /judge-runtime-paths.yml; echo '  crt_x86_in_lib32: true' >> /judge-runtime-paths.yml; grep -q 'g++23:' /judge-runtime-paths.yml; grep -q 'custom-invocation-request' /judge/dmoj/packet.py; g++ --version | head -1; printf '%s\n' '#include <print>' 'int main(){std::println("{}", 23);}' > /tmp/cpp23.cpp; g++ -std=gnu++23 /tmp/cpp23.cpp -O2 -static -o /tmp/cpp23; /tmp/cpp23
